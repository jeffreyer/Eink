#include "text.h"
#include <Arduino.h>
#include <stdio.h>
#include "common.h"
#include "esp_partition.h"

uint8_t text[] = {'H','e','l','l','o','1','2','3',0xCF, 0xC8, 0xB5, 0xDB, 0xB4, 0xB4, 0xD2, 0xB5, 0xCE, 0xB4, 0xB0, 0xEB,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 0xA1, 0xA3};
int text_index=0;
bool single_finish=true;
uint8_t *last_glyph;

int gb2312_to_index(uint8_t high, uint8_t low)
{
    if (high==0)
        return low-0x20;
    if (high >= 0xB0 && high <= 0xD7) {
        return (high - 0xB0) * 94 + (low - 0xA1) + 95;
    }
    if (high >= 0xD8 && high <= 0xF7) {
        return (high - 0xD8 + 40) * 94 + (low - 0xA1) + 95;
    }
    return -1;
}

#define FONT_BASE_ADDR 0x390000
#define FONT_PAGE_SIZE (256 * 8)   // 256字/页 × 8 bytes
#define PAGE_CHAR_COUNT 256

typedef struct {
    uint16_t page_id;
    uint8_t data[PAGE_CHAR_COUNT * 8];
    bool valid;
} font_page_t;

font_page_t cache[2];  // 双页缓存

const esp_partition_t* font_part;

void init_font_partition()
{
    font_part = esp_partition_find_first(
        ESP_PARTITION_TYPE_DATA,
        ESP_PARTITION_SUBTYPE_ANY,
        "font"
    );

    if (!font_part) {
        Serial.println("Font partition not found!");
    }
}

bool font_read(uint32_t offset, void* buffer, uint32_t len)
{
    if (!font_part) return false;

    esp_err_t err = esp_partition_read(
        font_part,
        offset,
        buffer,
        len
    );

    return err == ESP_OK;
}

void load_page(uint16_t page_id)
{
    // 查缓存
    for (int i = 0; i < 2; i++) {
        if (cache[i].valid && cache[i].page_id == page_id) return;
    }

    // 替换策略（简单LRU）
    int slot = 0;
    cache[slot].page_id = page_id;
    cache[slot].valid = true;

    // uint32_t addr = FONT_BASE_ADDR + page_id * FONT_PAGE_SIZE;

    // spi_flash_read(addr, cache[slot].data, FONT_PAGE_SIZE);

    uint32_t offset = page_id * FONT_PAGE_SIZE;
    font_read(offset, cache[slot].data, FONT_PAGE_SIZE);
}

uint8_t* get_glyph(uint16_t index)
{
    uint16_t page = index / PAGE_CHAR_COUNT;
    uint16_t offset = index % PAGE_CHAR_COUNT;

    load_page(page);

    for (int i = 0; i < 2; i++) {
        if (cache[i].page_id == page) {
            return &cache[i].data[offset * 8];
        }
    }

    return NULL;
}


void text_loop()
{

}

int setup_text(){
    init_font_partition();
    
    return 0;

}

int unload_text(){
    return 0;
}